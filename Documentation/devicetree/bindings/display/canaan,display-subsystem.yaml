## Documentation/devicetree/bindings/display/canaan,display-subsystem.yaml
```yaml
# SPDX-License-Identifier: (GPL-2.0-only OR BSD-2-Clause)
%YAML 1.2
---
$id: http://devicetree.org/schemas/display/canaan,display-subsystem.yaml#
$schema: http://devicetree.org/meta-schemas/core.yaml#

title: Canaan K230 DRM master device

maintainers:
  - Sungjoon Moon <sumoon@seoulsaram.org>

description:
  The Canaan K230 DRM master device is a virtual device needed to list all
  display controller nodes that comprise the graphics subsystem.

properties:
  compatible:
    const: canaan,display-subsystem

  ports:
    $ref: /schemas/types.yaml#/definitions/phandle-array
    items:
      maxItems: 1
    description:
      List of phandles pointing to output ports of the display controller.

required:
  - compatible
  - ports

additionalProperties: false

examples:
  - |
    display-subsystem {
        compatible = "canaan,display-subsystem";
        ports = <&vo_out>;
    };

...
```

## Documentation/devicetree/bindings/display/canaan,k230-mipi-dsi.yaml
```yaml
# SPDX-License-Identifier: (GPL-2.0-only OR BSD-2-Clause)
%YAML 1.2
---
$id: http://devicetree.org/schemas/display/canaan,k230-mipi-dsi.yaml#
$schema: http://devicetree.org/meta-schemas/core.yaml#

title: Canaan K230 MIPI-DSI Host Controller

maintainers:
  - Sungjoon Moon <sumoon@seoulsaram.org>

description:
  The Canaan K230 MIPI-DSI host controller converts parallel display data
  from the K230 Video Output controller into MIPI-DSI signals. It can drive
  a MIPI-DSI panel directly or connect to an external bridge such as the
  Lontium LT9611 DSI-to-HDMI converter.

allOf:
  - $ref: dsi-controller.yaml#

properties:
  compatible:
    const: canaan,k230-mipi-dsi

  reg:
    maxItems: 1

  clocks:
    maxItems: 2

  clock-names:
    items:
      - const: pclk
      - const: pixel
    description:
      pclk is the DSI host APB clock consumed by the DW MIPI DSI library;
      pixel is the display pixel clock consumed by the K230 glue.

  ports:
    $ref: /schemas/graph.yaml#/properties/ports

    properties:
      port@0:
        $ref: /schemas/graph.yaml#/properties/port
        description:
          Input port receiving data from the Video Output controller.

      port@1:
        $ref: /schemas/graph.yaml#/properties/port
        description:
          Output port connecting to a DSI panel or bridge.

    required:
      - port@0
      - port@1

required:
  - compatible
  - reg
  - clocks
  - clock-names
  - ports

unevaluatedProperties: false

examples:
  - |
    dsi@90850000 {
        compatible = "canaan,k230-mipi-dsi";
        reg = <0x90850000 0x1000>;
        clocks = <&clk 0>, <&clk 1>;
        clock-names = "pclk", "pixel";
        #address-cells = <1>;
        #size-cells = <0>;

        ports {
            #address-cells = <1>;
            #size-cells = <0>;

            port@0 {
                reg = <0>;
                dsi_in: endpoint {
                    remote-endpoint = <&vo_out>;
                };
            };

            port@1 {
                reg = <1>;
                dsi_out: endpoint {
                    remote-endpoint = <&bridge_in>;
                };
            };
        };
    };

...
```

## Documentation/devicetree/bindings/display/canaan,k230-vo.yaml
```yaml
# SPDX-License-Identifier: (GPL-2.0-only OR BSD-2-Clause)
%YAML 1.2
---
$id: http://devicetree.org/schemas/display/canaan,k230-vo.yaml#
$schema: http://devicetree.org/meta-schemas/core.yaml#

title: Canaan K230 Video Output Controller

maintainers:
  - Sungjoon Moon <sumoon@seoulsaram.org>

description:
  The Canaan K230 Video Output (VO) controller is the display controller
  found in the K230 SoC. It supports multiple overlay planes (video layers
  and OSD layers) and drives a MIPI-DSI output.

properties:
  compatible:
    const: canaan,k230-vo

  reg:
    maxItems: 1

  interrupts:
    maxItems: 1

  resets:
    maxItems: 1

  port:
    $ref: /schemas/graph.yaml#/properties/port
    unevaluatedProperties: false
    description:
      Output port connecting to the MIPI-DSI controller.

required:
  - compatible
  - reg
  - interrupts
  - port

additionalProperties: false

examples:
  - |
    #include <dt-bindings/interrupt-controller/irq.h>

    vo: vo@90840000 {
        compatible = "canaan,k230-vo";
        reg = <0x90840000 0x10000>;
        interrupts = <133 IRQ_TYPE_LEVEL_HIGH>;

        port {
            vo_out: endpoint {
                remote-endpoint = <&dsi_in>;
            };
        };
    };

...
```

## drivers/gpu/drm/canaan/Kconfig
```kconfig
# SPDX-License-Identifier: GPL-2.0-only
config DRM_CANAAN
	tristate "DRM Support for Canaan K230 Display Controller"
	depends on OF
	depends on COMMON_CLK
	depends on DRM
	select DRM_KMS_HELPER
	select DRM_GEM_DMA_HELPER
	select DRM_MIPI_DSI
	select DRM_DW_MIPI_DSI
	select DRM_DISPLAY_HELPER
	select DRM_BRIDGE_CONNECTOR
	select VIDEOMODE_HELPERS
	default ARCH_CANAAN
	help
	  Choose this option if you have a Canaan K230 soc chipset.
	  This driver provides kernel mode setting and buffer
	  management to userspace. This driver does not provide
	  2D or 3D acceleration; acceleration is performed by other
	  IP found on the SoC.

	  It includes the MIPI-DSI host, built on top of the generic
	  Synopsys DesignWare MIPI DSI bridge library, which can drive
	  a DSI panel or an external bridge such as the Lontium LT9611.
```
